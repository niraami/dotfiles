; GridLines Meters 
; Coverage 1920x1080 pixels
; 5 lines per 100 pixels :: (1920/100)*5=96 vertical line meters | (1080/100)*5=54 horizontal line meters
; Meters are drawn from Center-Line outward in all directions
;
;-----------------------------------------------------------------------------------------------------------------
; Horizontal Line Meters
;-----------------------------------------------------------------------------------------------------------------

[MeterHorizontalLine1B]
Meter=Image
X=0
Y=([MeterHorizontalCenterLine:Y]+#Hor#)
W=#SCREENAREAWIDTH#
H=1
SolidColor=#GridColor#
DynamicVariables=1

[MeterHorizontalLine2B]
Meter=Image
X=0
Y=(#Hor#)r
W=#SCREENAREAWIDTH#
H=1
SolidColor=#GridColor#
DynamicVariables=1
Hidden=(#Hor#*2>#SCREENAREAHEIGHT#?)

[MeterHorizontalLine3B]
Meter=Image
X=0
Y=(#Hor#)r
W=#SCREENAREAWIDTH#
H=1
SolidColor=#GridColor#
DynamicVariables=1
Hidden=(#Hor#*3>#SCREENAREAHEIGHT#?)

[MeterHorizontalLine4B]
Meter=Image
X=0
Y=(#Hor#)r
W=#SCREENAREAWIDTH#
H=1
SolidColor=#GridColor#
DynamicVariables=1
Hidden=(#Hor#*4>#SCREENAREAHEIGHT#?)

[MeterHorizontalLine5B]
Meter=Image
X=0
Y=(#Hor#)r
W=#SCREENAREAWIDTH#
H=1
SolidColor=#GridColor#
DynamicVariables=1
Hidden=(#Hor#*5>#SCREENAREAHEIGHT#?)

[MeterHorizontalLine6B]
Meter=Image
X=0
Y=(#Hor#)r
W=#SCREENAREAWIDTH#
H=1
SolidColor=#GridColor#
DynamicVariables=1
Hidden=(#Hor#*6>#SCREENAREAHEIGHT#?)

[MeterHorizontalLine7B]
Meter=Image
X=0
Y=(#Hor#)r
W=#SCREENAREAWIDTH#
H=1
SolidColor=#GridColor#
DynamicVariables=1
Hidden=(#Hor#*7>#SCREENAREAHEIGHT#?)

[MeterHorizontalLine8B]
Meter=Image
X=0
Y=(#Hor#)r
W=#SCREENAREAWIDTH#
H=1
SolidColor=#GridColor#
DynamicVariables=1
Hidden=(#Hor#*8>#SCREENAREAHEIGHT#?)

[MeterHorizontalLine9B]
Meter=Image
X=0
Y=(#Hor#)r
W=#SCREENAREAWIDTH#
H=1
SolidColor=#GridColor#
DynamicVariables=1
Hidden=(#Hor#*9>#SCREENAREAHEIGHT#?)

[MeterHorizontalLine10B]
Meter=Image
X=0
Y=(#Hor#)r
W=#SCREENAREAWIDTH#
H=1
SolidColor=#GridColor#
DynamicVariables=1
Hidden=(#Hor#*10>#SCREENAREAHEIGHT#?)

[MeterHorizontalLine11B]
Meter=Image
X=0
Y=(#Hor#)r
W=#SCREENAREAWIDTH#
H=1
SolidColor=#GridColor#
DynamicVariables=1
Hidden=(#Hor#*11>#SCREENAREAHEIGHT#?)

[MeterHorizontalLine12B]
Meter=Image
X=0
Y=(#Hor#)r
W=#SCREENAREAWIDTH#
H=1
SolidColor=#GridColor#
DynamicVariables=1
Hidden=(#Hor#*12>#SCREENAREAHEIGHT#?)

[MeterHorizontalLine13B]
Meter=Image
X=0
Y=(#Hor#)r
W=#SCREENAREAWIDTH#
H=1
SolidColor=#GridColor#
DynamicVariables=1
Hidden=(#Hor#*13>#SCREENAREAHEIGHT#?)

[MeterHorizontalLine14B]
Meter=Image
X=0
Y=(#Hor#)r
W=#SCREENAREAWIDTH#
H=1
SolidColor=#GridColor#
DynamicVariables=1
Hidden=(#Hor#*14>#SCREENAREAHEIGHT#?)

[MeterHorizontalLine15B]
Meter=Image
X=0
Y=(#Hor#)r
W=#SCREENAREAWIDTH#
H=1
SolidColor=#GridColor#
DynamicVariables=1
Hidden=(#Hor#*15>#SCREENAREAHEIGHT#?)

[MeterHorizontalLine16B]
Meter=Image
X=0
Y=(#Hor#)r
W=#SCREENAREAWIDTH#
H=1
SolidColor=#GridColor#
DynamicVariables=1
Hidden=(#Hor#*16>#SCREENAREAHEIGHT#?)

[MeterHorizontalLine17B]
Meter=Image
X=0
Y=(#Hor#)r
W=#SCREENAREAWIDTH#
H=1
SolidColor=#GridColor#
DynamicVariables=1
Hidden=(#Hor#*17>#SCREENAREAHEIGHT#?)

[MeterHorizontalLine18B]
Meter=Image
X=0
Y=(#Hor#)r
W=#SCREENAREAWIDTH#
H=1
SolidColor=#GridColor#
DynamicVariables=1
Hidden=(#Hor#*18>#SCREENAREAHEIGHT#?)

[MeterHorizontalLine19B]
Meter=Image
X=0
Y=(#Hor#)r
W=#SCREENAREAWIDTH#
H=1
SolidColor=#GridColor#
DynamicVariables=1
Hidden=(#Hor#*19>#SCREENAREAHEIGHT#?)

[MeterHorizontalLine20B]
Meter=Image
X=0
Y=(#Hor#)r
W=#SCREENAREAWIDTH#
H=1
SolidColor=#GridColor#
DynamicVariables=1
Hidden=(#Hor#*20>#SCREENAREAHEIGHT#?)

[MeterHorizontalLine21B]
Meter=Image
X=0
Y=(#Hor#)r
W=#SCREENAREAWIDTH#
H=1
SolidColor=#GridColor#
DynamicVariables=1
Hidden=(#Hor#*21>#SCREENAREAHEIGHT#?)

[MeterHorizontalLine22B]
Meter=Image
X=0
Y=(#Hor#)r
W=#SCREENAREAWIDTH#
H=1
SolidColor=#GridColor#
DynamicVariables=1
Hidden=(#Hor#*22>#SCREENAREAHEIGHT#?)

[MeterHorizontalLine23B]
Meter=Image
X=0
Y=(#Hor#)r
W=#SCREENAREAWIDTH#
H=1
SolidColor=#GridColor#
DynamicVariables=1
Hidden=(#Hor#*23>#SCREENAREAHEIGHT#?)

[MeterHorizontalLine24B]
Meter=Image
X=0
Y=(#Hor#)r
W=#SCREENAREAWIDTH#
H=1
SolidColor=#GridColor#
DynamicVariables=1
Hidden=(#Hor#*24>#SCREENAREAHEIGHT#?)

[MeterHorizontalLine25B]
Meter=Image
X=0
Y=(#Hor#)r
W=#SCREENAREAWIDTH#
H=1
SolidColor=#GridColor#
DynamicVariables=1
Hidden=(#Hor#*25>#SCREENAREAHEIGHT#?)

[MeterHorizontalLine26B]
Meter=Image
X=0
Y=(#Hor#)r
W=#SCREENAREAWIDTH#
H=1
SolidColor=#GridColor#
DynamicVariables=1
Hidden=(#Hor#*26>#SCREENAREAHEIGHT#?)

[MeterHorizontalLine27B]
Meter=Image
X=0
Y=(#Hor#)r
W=#SCREENAREAWIDTH#
H=1
SolidColor=#GridColor#
DynamicVariables=1
Hidden=(#Hor#*27>#SCREENAREAHEIGHT#?)

[MeterHorizontalLine1T]
Meter=Image
X=0
Y=(([MeterHorizontalCenterLine:Y])-#Hor#)
W=#SCREENAREAWIDTH#
H=1
SolidColor=#GridColor#
DynamicVariables=1
Hidden=(#Hor#*1>#SCREENAREAHEIGHT#/2?)

[MeterHorizontalLine2T]
Meter=Image
X=0
Y=(-#Hor#)r
W=#SCREENAREAWIDTH#
H=1
SolidColor=#GridColor#
DynamicVariables=1
Hidden=(#Hor#*2>#SCREENAREAHEIGHT#/2?)

[MeterHorizontalLine3T]
Meter=Image
X=0
Y=(-#Hor#)r
W=#SCREENAREAWIDTH#
H=1
SolidColor=#GridColor#
DynamicVariables=1
Hidden=(#Hor#*3>#SCREENAREAHEIGHT#/2?)

[MeterHorizontalLine4T]
Meter=Image
X=0
Y=(-#Hor#)r
W=#SCREENAREAWIDTH#
H=1
SolidColor=#GridColor#
DynamicVariables=1
Hidden=(#Hor#*4>#SCREENAREAHEIGHT#/2?)

[MeterHorizontalLine5T]
Meter=Image
X=0
Y=(-#Hor#)r
W=#SCREENAREAWIDTH#
H=1
SolidColor=#GridColor#
DynamicVariables=1
Hidden=(#Hor#*5>#SCREENAREAHEIGHT#?/2)

[MeterHorizontalLine6T]
Meter=Image
X=0
Y=(-#Hor#)r
W=#SCREENAREAWIDTH#
H=1
SolidColor=#GridColor#
DynamicVariables=1
Hidden=(#Hor#*6>#SCREENAREAHEIGHT#/2?)

[MeterHorizontalLine7T]
Meter=Image
X=0
Y=(-#Hor#)r
W=#SCREENAREAWIDTH#
H=1
SolidColor=#GridColor#
DynamicVariables=1
Hidden=(#Hor#*7>#SCREENAREAHEIGHT#/2?)

[MeterHorizontalLine8T]
Meter=Image
X=0
Y=(-#Hor#)r
W=#SCREENAREAWIDTH#
H=1
SolidColor=#GridColor#
DynamicVariables=1
Hidden=(#Hor#*8>#SCREENAREAHEIGHT#/2?)

[MeterHorizontalLine9T]
Meter=Image
X=0
Y=(-#Hor#)r
W=#SCREENAREAWIDTH#
H=1
SolidColor=#GridColor#
DynamicVariables=1
Hidden=(#Hor#*9>#SCREENAREAHEIGHT#/2?)

[MeterHorizontalLine10T]
Meter=Image
X=0
Y=(-#Hor#)r
W=#SCREENAREAWIDTH#
H=1
SolidColor=#GridColor#
DynamicVariables=1
Hidden=(#Hor#*10>#SCREENAREAHEIGHT#/2?)

[MeterHorizontalLine11T]
Meter=Image
X=0
Y=(-#Hor#)r
W=#SCREENAREAWIDTH#
H=1
SolidColor=#GridColor#
DynamicVariables=1
Hidden=(#Hor#*11>#SCREENAREAHEIGHT#/2?)

[MeterHorizontalLine12T]
Meter=Image
X=0
Y=(-#Hor#)r
W=#SCREENAREAWIDTH#
H=1
SolidColor=#GridColor#
DynamicVariables=1
Hidden=(#Hor#*12>#SCREENAREAHEIGHT#/2?)

[MeterHorizontalLine13T]
Meter=Image
X=0
Y=(-#Hor#)r
W=#SCREENAREAWIDTH#
H=1
SolidColor=#GridColor#
DynamicVariables=1
Hidden=(#Hor#*13>#SCREENAREAHEIGHT#/2?)

[MeterHorizontalLine14T]
Meter=Image
X=0
Y=(-#Hor#)r
W=#SCREENAREAWIDTH#
H=1
SolidColor=#GridColor#
DynamicVariables=1
Hidden=(#Hor#*14>#SCREENAREAHEIGHT#/2?)

[MeterHorizontalLine15T]
Meter=Image
X=0
Y=(-#Hor#)r
W=#SCREENAREAWIDTH#
H=1
SolidColor=#GridColor#
DynamicVariables=1
Hidden=(#Hor#*15>#SCREENAREAHEIGHT#/2?)

[MeterHorizontalLine16T]
Meter=Image
X=0
Y=(-#Hor#)r
W=#SCREENAREAWIDTH#
H=1
SolidColor=#GridColor#
DynamicVariables=1
Hidden=(#Hor#*16>#SCREENAREAHEIGHT#/2?)

[MeterHorizontalLine17T]
Meter=Image
X=0
Y=(-#Hor#)r
W=#SCREENAREAWIDTH#
H=1
SolidColor=#GridColor#
DynamicVariables=1
Hidden=(#Hor#*17>#SCREENAREAHEIGHT#/2?)

[MeterHorizontalLine18T]
Meter=Image
X=0
Y=(-#Hor#)r
W=#SCREENAREAWIDTH#
H=1
SolidColor=#GridColor#
DynamicVariables=1
Hidden=(#Hor#*18>#SCREENAREAHEIGHT#/2?)

[MeterHorizontalLine19T]
Meter=Image
X=0
Y=(-#Hor#)r
W=#SCREENAREAWIDTH#
H=1
SolidColor=#GridColor#
DynamicVariables=1
Hidden=(#Hor#*19>#SCREENAREAHEIGHT#/2?)

[MeterHorizontalLine20T]
Meter=Image
X=0
Y=(-#Hor#)r
W=#SCREENAREAWIDTH#
H=1
SolidColor=#GridColor#
DynamicVariables=1
Hidden=(#Hor#*20>#SCREENAREAHEIGHT#/2?)

[MeterHorizontalLine21T]
Meter=Image
X=0
Y=(-#Hor#)r
W=#SCREENAREAWIDTH#
H=1
SolidColor=#GridColor#
DynamicVariables=1
Hidden=(#Hor#*21>#SCREENAREAHEIGHT#/2?)

[MeterHorizontalLine22T]
Meter=Image
X=0
Y=(-#Hor#)r
W=#SCREENAREAWIDTH#
H=1
SolidColor=#GridColor#
DynamicVariables=1
Hidden=(#Hor#*22>#SCREENAREAHEIGHT#/2?)

[MeterHorizontalLine23T]
Meter=Image
X=0
Y=(-#Hor#)r
W=#SCREENAREAWIDTH#
H=1
SolidColor=#GridColor#
DynamicVariables=1
Hidden=(#Hor#*23>#SCREENAREAHEIGHT#/2?)

[MeterHorizontalLine24T]
Meter=Image
X=0
Y=(-#Hor#)r
W=#SCREENAREAWIDTH#
H=1
SolidColor=#GridColor#
DynamicVariables=1
Hidden=(#Hor#*24>#SCREENAREAHEIGHT#/2?)

[MeterHorizontalLine25T]
Meter=Image
X=0
Y=(-#Hor#)r
W=#SCREENAREAWIDTH#
H=1
SolidColor=#GridColor#
DynamicVariables=1
Hidden=(#Hor#*25>#SCREENAREAHEIGHT#/2?)

[MeterHorizontalLine26T]
Meter=Image
X=0
Y=(-#Hor#)r
W=#SCREENAREAWIDTH#
H=1
SolidColor=#GridColor#
DynamicVariables=1
Hidden=(#Hor#*26>#SCREENAREAHEIGHT#/2?)

[MeterHorizontalLine27T]
Meter=Image
X=0
Y=(-#Hor#)r
W=#SCREENAREAWIDTH#
H=1
SolidColor=#GridColor#
DynamicVariables=1
Hidden=(#Hor#*27>#SCREENAREAHEIGHT#/2?)

;-----------------------------------------------------------------------------------------------------------------
; Vertical Line Meters
;-----------------------------------------------------------------------------------------------------------------


[MeterVerticalLine1R]
Meter=Image
Y=0
X=([MeterVerticalCenterLine:X]+#Ver#)
H=#SCREENAREAHEIGHT#
W=1
SolidColor=#GridColor#
DynamicVariables=1

[MeterVerticalLine2R]
Meter=Image
Y=0
X=(#Ver#)r
H=#SCREENAREAHEIGHT#
W=1
SolidColor=#GridColor#
DynamicVariables=1
Hidden=(#Ver#*2>#SCREENAREAWIDTH#/2?)

[MeterVerticalLine3R]
Meter=Image
Y=0
X=(#Ver#)r
H=#SCREENAREAHEIGHT#
W=1
SolidColor=#GridColor#
DynamicVariables=1
Hidden=(#Ver#*3>#SCREENAREAWIDTH#/2?)

[MeterVerticalLine4R]
Meter=Image
Y=0
X=(#Ver#)r
H=#SCREENAREAHEIGHT#
W=1
SolidColor=#GridColor#
DynamicVariables=1
Hidden=(#Ver#*4>#SCREENAREAWIDTH#/2?)

[MeterVerticalLine5R]
Meter=Image
Y=0
X=(#Ver#)r
H=#SCREENAREAHEIGHT#
W=1
SolidColor=#GridColor#
DynamicVariables=1
Hidden=(#Ver#*5>#SCREENAREAWIDTH#/2?)

[MeterVerticalLine6R]
Meter=Image
Y=0
X=(#Ver#)r
H=#SCREENAREAHEIGHT#
W=1
SolidColor=#GridColor#
DynamicVariables=1
Hidden=(#Ver#*6>#SCREENAREAWIDTH#/2?)

[MeterVerticalLine7R]
Meter=Image
Y=0
X=(#Ver#)r
H=#SCREENAREAHEIGHT#
W=1
SolidColor=#GridColor#
DynamicVariables=1
Hidden=(#Ver#*7>#SCREENAREAWIDTH#/2?)

[MeterVerticalLine8R]
Meter=Image
Y=0
X=(#Ver#)r
H=#SCREENAREAHEIGHT#
W=1
SolidColor=#GridColor#
DynamicVariables=1
Hidden=(#Ver#*8>#SCREENAREAWIDTH#/2?)

[MeterVerticalLine9R]
Meter=Image
Y=0
X=(#Ver#)r
H=#SCREENAREAHEIGHT#
W=1
SolidColor=#GridColor#
DynamicVariables=1
Hidden=(#Ver#*9>#SCREENAREAWIDTH#/2?)

[MeterVerticalLine10R]
Meter=Image
Y=0
X=(#Ver#)r
H=#SCREENAREAHEIGHT#
W=1
SolidColor=#GridColor#
DynamicVariables=1
Hidden=(#Ver#*10>#SCREENAREAWIDTH#/2?)

[MeterVerticalLine11R]
Meter=Image
Y=0
X=(#Ver#)r
H=#SCREENAREAHEIGHT#
W=1
SolidColor=#GridColor#
DynamicVariables=1
Hidden=(#Ver#*11>#SCREENAREAWIDTH#/2?)

[MeterVerticalLine12R]
Meter=Image
Y=0
X=(#Ver#)r
H=#SCREENAREAHEIGHT#
W=1
SolidColor=#GridColor#
DynamicVariables=1
Hidden=(#Ver#*12>#SCREENAREAWIDTH#/2?)

[MeterVerticalLine13R]
Meter=Image
Y=0
X=(#Ver#)r
H=#SCREENAREAHEIGHT#
W=1
SolidColor=#GridColor#
DynamicVariables=1
Hidden=(#Ver#*13>#SCREENAREAWIDTH#/2?)

[MeterVerticalLine14R]
Meter=Image
Y=0
X=(#Ver#)r
H=#SCREENAREAHEIGHT#
W=1
SolidColor=#GridColor#
DynamicVariables=1
Hidden=(#Ver#*14>#SCREENAREAWIDTH#/2?)

[MeterVerticalLine15R]
Meter=Image
Y=0
X=(#Ver#)r
H=#SCREENAREAHEIGHT#
W=1
SolidColor=#GridColor#
DynamicVariables=1
Hidden=(#Ver#*15>#SCREENAREAWIDTH#/2?)

[MeterVerticalLine16R]
Meter=Image
Y=0
X=(#Ver#)r
H=#SCREENAREAHEIGHT#
W=1
SolidColor=#GridColor#
DynamicVariables=1
Hidden=(#Ver#*16>#SCREENAREAWIDTH#/2?)

[MeterVerticalLine17R]
Meter=Image
Y=0
X=(#Ver#)r
H=#SCREENAREAHEIGHT#
W=1
SolidColor=#GridColor#
DynamicVariables=1
Hidden=(#Ver#*17>#SCREENAREAWIDTH#/2?)

[MeterVerticalLine18R]
Meter=Image
Y=0
X=(#Ver#)r
H=#SCREENAREAHEIGHT#
W=1
SolidColor=#GridColor#
DynamicVariables=1
Hidden=(#Ver#*18>#SCREENAREAWIDTH#/2?)

[MeterVerticalLine19R]
Meter=Image
Y=0
X=(#Ver#)r
H=#SCREENAREAHEIGHT#
W=1
SolidColor=#GridColor#
DynamicVariables=1
Hidden=(#Ver#*19>#SCREENAREAWIDTH#/2?)

[MeterVerticalLine20R]
Meter=Image
Y=0
X=(#Ver#)r
H=#SCREENAREAHEIGHT#
W=1
SolidColor=#GridColor#
DynamicVariables=1
Hidden=(#Ver#*20>#SCREENAREAWIDTH#/2?)

[MeterVerticalLine21R]
Meter=Image
Y=0
X=(#Ver#)r
H=#SCREENAREAHEIGHT#
W=1
SolidColor=#GridColor#
DynamicVariables=1
Hidden=(#Ver#*21>#SCREENAREAWIDTH#/2?)

[MeterVerticalLine22R]
Meter=Image
Y=0
X=(#Ver#)r
H=#SCREENAREAHEIGHT#
W=1
SolidColor=#GridColor#
DynamicVariables=1
Hidden=(#Ver#*22>#SCREENAREAWIDTH#/2?)

[MeterVerticalLine23R]
Meter=Image
Y=0
X=(#Ver#)r
H=#SCREENAREAHEIGHT#
W=1
SolidColor=#GridColor#
DynamicVariables=1
Hidden=(#Ver#*23>#SCREENAREAWIDTH#/2?)

[MeterVerticalLine24R]
Meter=Image
Y=0
X=(#Ver#)r
H=#SCREENAREAHEIGHT#
W=1
SolidColor=#GridColor#
DynamicVariables=1
Hidden=(#Ver#*24>#SCREENAREAWIDTH#/2?)

[MeterVerticalLine25R]
Meter=Image
Y=0
X=(#Ver#)r
H=#SCREENAREAHEIGHT#
W=1
SolidColor=#GridColor#
DynamicVariables=1
Hidden=(#Ver#*25>#SCREENAREAWIDTH#/2?)

[MeterVerticalLine26R]
Meter=Image
Y=0
X=(#Ver#)r
H=#SCREENAREAHEIGHT#
W=1
SolidColor=#GridColor#
DynamicVariables=1
Hidden=(#Ver#*26>#SCREENAREAWIDTH#/2?)

[MeterVerticalLine27R]
Meter=Image
Y=0
X=(#Ver#)r
H=#SCREENAREAHEIGHT#
W=1
SolidColor=#GridColor#
DynamicVariables=1
Hidden=(#Ver#*27>#SCREENAREAWIDTH#/2?)

[MeterVerticalLine28R]
Meter=Image
Y=0
X=(#Ver#)r
H=#SCREENAREAHEIGHT#
W=1
SolidColor=#GridColor#
DynamicVariables=1
Hidden=(#Ver#*28>#SCREENAREAWIDTH#/2?)

[MeterVerticalLine29R]
Meter=Image
Y=0
X=(#Ver#)r
H=#SCREENAREAHEIGHT#
W=1
SolidColor=#GridColor#
DynamicVariables=1
Hidden=(#Ver#*29>#SCREENAREAWIDTH#/2?)

[MeterVerticalLine30R]
Meter=Image
Y=0
X=(#Ver#)r
H=#SCREENAREAHEIGHT#
W=1
SolidColor=#GridColor#
DynamicVariables=1
Hidden=(#Ver#*30>#SCREENAREAWIDTH#/2?)

[MeterVerticalLine31R]
Meter=Image
Y=0
X=(#Ver#)r
H=#SCREENAREAHEIGHT#
W=1
SolidColor=#GridColor#
DynamicVariables=1
Hidden=(#Ver#*31>#SCREENAREAWIDTH#/2?)

[MeterVerticalLine32R]
Meter=Image
Y=0
X=(#Ver#)r
H=#SCREENAREAHEIGHT#
W=1
SolidColor=#GridColor#
DynamicVariables=1
Hidden=(#Ver#*32>#SCREENAREAWIDTH#/2?)

[MeterVerticalLine33R]
Meter=Image
Y=0
X=(#Ver#)r
H=#SCREENAREAHEIGHT#
W=1
SolidColor=#GridColor#
DynamicVariables=1
Hidden=(#Ver#*33>#SCREENAREAWIDTH#/2?)

[MeterVerticalLine34R]
Meter=Image
Y=0
X=(#Ver#)r
H=#SCREENAREAHEIGHT#
W=1
SolidColor=#GridColor#
DynamicVariables=1
Hidden=(#Ver#*34>#SCREENAREAWIDTH#/2?)

[MeterVerticalLine35R]
Meter=Image
Y=0
X=(#Ver#)r
H=#SCREENAREAHEIGHT#
W=1
SolidColor=#GridColor#
DynamicVariables=1
Hidden=(#Ver#*35>#SCREENAREAWIDTH#/2?)

[MeterVerticalLine36R]
Meter=Image
Y=0
X=(#Ver#)r
H=#SCREENAREAHEIGHT#
W=1
SolidColor=#GridColor#
DynamicVariables=1
Hidden=(#Ver#*36>#SCREENAREAWIDTH#/2?)

[MeterVerticalLine37R]
Meter=Image
Y=0
X=(#Ver#)r
H=#SCREENAREAHEIGHT#
W=1
SolidColor=#GridColor#
DynamicVariables=1
Hidden=(#Ver#*37>#SCREENAREAWIDTH#/2?)

[MeterVerticalLine38R]
Meter=Image
Y=0
X=(#Ver#)r
H=#SCREENAREAHEIGHT#
W=1
SolidColor=#GridColor#
DynamicVariables=1
Hidden=(#Ver#*38>#SCREENAREAWIDTH#/2?)

[MeterVerticalLine39R]
Meter=Image
Y=0
X=(#Ver#)r
H=#SCREENAREAHEIGHT#
W=1
SolidColor=#GridColor#
DynamicVariables=1
Hidden=(#Ver#*39>#SCREENAREAWIDTH#/2?)

[MeterVerticalLine40R]
Meter=Image
Y=0
X=(#Ver#)r
H=#SCREENAREAHEIGHT#
W=1
SolidColor=#GridColor#
DynamicVariables=1
Hidden=(#Ver#*40>#SCREENAREAWIDTH#/2?)

[MeterVerticalLine41R]
Meter=Image
Y=0
X=(#Ver#)r
H=#SCREENAREAHEIGHT#
W=1
SolidColor=#GridColor#
DynamicVariables=1
Hidden=(#Ver#*41>#SCREENAREAWIDTH#/2?)

[MeterVerticalLine42R]
Meter=Image
Y=0
X=(#Ver#)r
H=#SCREENAREAHEIGHT#
W=1
SolidColor=#GridColor#
DynamicVariables=1
Hidden=(#Ver#*42>#SCREENAREAWIDTH#/2?)

[MeterVerticalLine43R]
Meter=Image
Y=0
X=(#Ver#)r
H=#SCREENAREAHEIGHT#
W=1
SolidColor=#GridColor#
DynamicVariables=1
Hidden=(#Ver#*43>#SCREENAREAWIDTH#/2?)

[MeterVerticalLine44R]
Meter=Image
Y=0
X=(#Ver#)r
H=#SCREENAREAHEIGHT#
W=1
SolidColor=#GridColor#
DynamicVariables=1
Hidden=(#Ver#*44>#SCREENAREAWIDTH#/2?)

[MeterVerticalLine45R]
Meter=Image
Y=0
X=(#Ver#)r
H=#SCREENAREAHEIGHT#
W=1
SolidColor=#GridColor#
DynamicVariables=1
Hidden=(#Ver#*45>#SCREENAREAWIDTH#/2?)

[MeterVerticalLine46R]
Meter=Image
Y=0
X=(#Ver#)r
H=#SCREENAREAHEIGHT#
W=1
SolidColor=#GridColor#
DynamicVariables=1
Hidden=(#Ver#*46>#SCREENAREAWIDTH#/2?)

[MeterVerticalLine47R]
Meter=Image
Y=0
X=(#Ver#)r
H=#SCREENAREAHEIGHT#
W=1
SolidColor=#GridColor#
DynamicVariables=1
Hidden=(#Ver#*47>#SCREENAREAWIDTH#/2?)

[MeterVerticalLine48R]
Meter=Image
Y=0
X=(#Ver#)r
H=#SCREENAREAHEIGHT#
W=1
SolidColor=#GridColor#
DynamicVariables=1
Hidden=(#Ver#*48>#SCREENAREAWIDTH#/2?)

[MeterVerticalLine1L]
Meter=Image
Y=0
X=(([MeterVerticalCenterLine:X])-#Ver#)
H=#SCREENAREAHEIGHT#
W=1
SolidColor=#GridColor#
DynamicVariables=1
Hidden=(#Ver#*1>#SCREENAREAWIDTH#/2?)

[MeterVerticalLine2L]
Meter=Image
Y=0
X=(-#Ver#)r
H=#SCREENAREAHEIGHT#
W=1
SolidColor=#GridColor#
DynamicVariables=1
Hidden=(#Ver#*2>#SCREENAREAWIDTH#/2?)

[MeterVerticalLine3L]
Meter=Image
Y=0
X=(-#Ver#)r
H=#SCREENAREAHEIGHT#
W=1
SolidColor=#GridColor#
DynamicVariables=1
Hidden=(#Ver#*3>#SCREENAREAWIDTH#/2?)

[MeterVerticalLine4L]
Meter=Image
Y=0
X=(-#Ver#)r
H=#SCREENAREAHEIGHT#
W=1
SolidColor=#GridColor#
DynamicVariables=1
Hidden=(#Ver#*4>#SCREENAREAWIDTH#/2?)

[MeterVerticalLine5L]
Meter=Image
Y=0
X=(-#Ver#)r
H=#SCREENAREAHEIGHT#
W=1
SolidColor=#GridColor#
DynamicVariables=1
Hidden=(#Ver#*5>#SCREENAREAWIDTH#/2?/2)

[MeterVerticalLine6L]
Meter=Image
Y=0
X=(-#Ver#)r
H=#SCREENAREAHEIGHT#
W=1
SolidColor=#GridColor#
DynamicVariables=1
Hidden=(#Ver#*6>#SCREENAREAWIDTH#/2?)

[MeterVerticalLine7L]
Meter=Image
Y=0
X=(-#Ver#)r
H=#SCREENAREAHEIGHT#
W=1
SolidColor=#GridColor#
DynamicVariables=1
Hidden=(#Ver#*7>#SCREENAREAWIDTH#/2?)

[MeterVerticalLine8L]
Meter=Image
Y=0
X=(-#Ver#)r
H=#SCREENAREAHEIGHT#
W=1
SolidColor=#GridColor#
DynamicVariables=1
Hidden=(#Ver#*8>#SCREENAREAWIDTH#/2?)

[MeterVerticalLine9L]
Meter=Image
Y=0
X=(-#Ver#)r
H=#SCREENAREAHEIGHT#
W=1
SolidColor=#GridColor#
DynamicVariables=1
Hidden=(#Ver#*9>#SCREENAREAWIDTH#/2?)

[MeterVerticalLine10L]
Meter=Image
Y=0
X=(-#Ver#)r
H=#SCREENAREAHEIGHT#
W=1
SolidColor=#GridColor#
DynamicVariables=1
Hidden=(#Ver#*10>#SCREENAREAWIDTH#/2?)

[MeterVerticalLine11L]
Meter=Image
Y=0
X=(-#Ver#)r
H=#SCREENAREAHEIGHT#
W=1
SolidColor=#GridColor#
DynamicVariables=1
Hidden=(#Ver#*11>#SCREENAREAWIDTH#/2?)

[MeterVerticalLine12L]
Meter=Image
Y=0
X=(-#Ver#)r
H=#SCREENAREAHEIGHT#
W=1
SolidColor=#GridColor#
DynamicVariables=1
Hidden=(#Ver#*12>#SCREENAREAWIDTH#/2?)

[MeterVerticalLine13L]
Meter=Image
Y=0
X=(-#Ver#)r
H=#SCREENAREAHEIGHT#
W=1
SolidColor=#GridColor#
DynamicVariables=1
Hidden=(#Ver#*13>#SCREENAREAWIDTH#/2?)

[MeterVerticalLine14L]
Meter=Image
Y=0
X=(-#Ver#)r
H=#SCREENAREAHEIGHT#
W=1
SolidColor=#GridColor#
DynamicVariables=1
Hidden=(#Ver#*14>#SCREENAREAWIDTH#/2?)

[MeterVerticalLine15L]
Meter=Image
Y=0
X=(-#Ver#)r
H=#SCREENAREAHEIGHT#
W=1
SolidColor=#GridColor#
DynamicVariables=1
Hidden=(#Ver#*15>#SCREENAREAWIDTH#/2?)

[MeterVerticalLine16L]
Meter=Image
Y=0
X=(-#Ver#)r
H=#SCREENAREAHEIGHT#
W=1
SolidColor=#GridColor#
DynamicVariables=1
Hidden=(#Ver#*16>#SCREENAREAWIDTH#/2?)

[MeterVerticalLine17L]
Meter=Image
Y=0
X=(-#Ver#)r
H=#SCREENAREAHEIGHT#
W=1
SolidColor=#GridColor#
DynamicVariables=1
Hidden=(#Ver#*17>#SCREENAREAWIDTH#/2?)

[MeterVerticalLine18L]
Meter=Image
Y=0
X=(-#Ver#)r
H=#SCREENAREAHEIGHT#
W=1
SolidColor=#GridColor#
DynamicVariables=1
Hidden=(#Ver#*18>#SCREENAREAWIDTH#/2?)

[MeterVerticalLine19L]
Meter=Image
Y=0
X=(-#Ver#)r
H=#SCREENAREAHEIGHT#
W=1
SolidColor=#GridColor#
DynamicVariables=1
Hidden=(#Ver#*19>#SCREENAREAWIDTH#/2?)

[MeterVerticalLine20L]
Meter=Image
Y=0
X=(-#Ver#)r
H=#SCREENAREAHEIGHT#
W=1
SolidColor=#GridColor#
DynamicVariables=1
Hidden=(#Ver#*20>#SCREENAREAWIDTH#/2?)

[MeterVerticalLine21L]
Meter=Image
Y=0
X=(-#Ver#)r
H=#SCREENAREAHEIGHT#
W=1
SolidColor=#GridColor#
DynamicVariables=1
Hidden=(#Ver#*21>#SCREENAREAWIDTH#/2?)

[MeterVerticalLine22L]
Meter=Image
Y=0
X=(-#Ver#)r
H=#SCREENAREAHEIGHT#
W=1
SolidColor=#GridColor#
DynamicVariables=1
Hidden=(#Ver#*22>#SCREENAREAWIDTH#/2?)

[MeterVerticalLine23L]
Meter=Image
Y=0
X=(-#Ver#)r
H=#SCREENAREAHEIGHT#
W=1
SolidColor=#GridColor#
DynamicVariables=1
Hidden=(#Ver#*23>#SCREENAREAWIDTH#/2?)

[MeterVerticalLine24L]
Meter=Image
Y=0
X=(-#Ver#)r
H=#SCREENAREAHEIGHT#
W=1
SolidColor=#GridColor#
DynamicVariables=1
Hidden=(#Ver#*24>#SCREENAREAWIDTH#/2?)

[MeterVerticalLine25L]
Meter=Image
Y=0
X=(-#Ver#)r
H=#SCREENAREAHEIGHT#
W=1
SolidColor=#GridColor#
DynamicVariables=1
Hidden=(#Ver#*25>#SCREENAREAWIDTH#/2?)

[MeterVerticalLine26L]
Meter=Image
Y=0
X=(-#Ver#)r
H=#SCREENAREAHEIGHT#
W=1
SolidColor=#GridColor#
DynamicVariables=1
Hidden=(#Ver#*26>#SCREENAREAWIDTH#/2?)

[MeterVerticalLine27L]
Meter=Image
Y=0
X=(-#Ver#)r
H=#SCREENAREAHEIGHT#
W=1
SolidColor=#GridColor#
DynamicVariables=1
Hidden=(#Ver#*27>#SCREENAREAWIDTH#/2?)

[MeterVerticalLine28L]
Meter=Image
Y=0
X=(-#Ver#)r
H=#SCREENAREAHEIGHT#
W=1
SolidColor=#GridColor#
DynamicVariables=1
Hidden=(#Ver#*28>#SCREENAREAWIDTH#/2?)

[MeterVerticalLine29L]
Meter=Image
Y=0
X=(-#Ver#)r
H=#SCREENAREAHEIGHT#
W=1
SolidColor=#GridColor#
DynamicVariables=1
Hidden=(#Ver#*29>#SCREENAREAWIDTH#/2?)

[MeterVerticalLine30L]
Meter=Image
Y=0
X=(-#Ver#)r
H=#SCREENAREAHEIGHT#
W=1
SolidColor=#GridColor#
DynamicVariables=1
Hidden=(#Ver#*30>#SCREENAREAWIDTH#/2?)

[MeterVerticalLine31L]
Meter=Image
Y=0
X=(-#Ver#)r
H=#SCREENAREAHEIGHT#
W=1
SolidColor=#GridColor#
DynamicVariables=1
Hidden=(#Ver#*31>#SCREENAREAWIDTH#/2?)

[MeterVerticalLine32L]
Meter=Image
Y=0
X=(-#Ver#)r
H=#SCREENAREAHEIGHT#
W=1
SolidColor=#GridColor#
DynamicVariables=1
Hidden=(#Ver#*32>#SCREENAREAWIDTH#/2?)

[MeterVerticalLine33L]
Meter=Image
Y=0
X=(-#Ver#)r
H=#SCREENAREAHEIGHT#
W=1
SolidColor=#GridColor#
DynamicVariables=1
Hidden=(#Ver#*33>#SCREENAREAWIDTH#/2?)

[MeterVerticalLine34L]
Meter=Image
Y=0
X=(-#Ver#)r
H=#SCREENAREAHEIGHT#
W=1
SolidColor=#GridColor#
DynamicVariables=1
Hidden=(#Ver#*34>#SCREENAREAWIDTH#/2?)

[MeterVerticalLine35L]
Meter=Image
Y=0
X=(-#Ver#)r
H=#SCREENAREAHEIGHT#
W=1
SolidColor=#GridColor#
DynamicVariables=1
Hidden=(#Ver#*35>#SCREENAREAWIDTH#/2?)

[MeterVerticalLine36L]
Meter=Image
Y=0
X=(-#Ver#)r
H=#SCREENAREAHEIGHT#
W=1
SolidColor=#GridColor#
DynamicVariables=1
Hidden=(#Ver#*36>#SCREENAREAWIDTH#/2?)

[MeterVerticalLine37L]
Meter=Image
Y=0
X=(-#Ver#)r
H=#SCREENAREAHEIGHT#
W=1
SolidColor=#GridColor#
DynamicVariables=1
Hidden=(#Ver#*37>#SCREENAREAWIDTH#/2?)

[MeterVerticalLine38L]
Meter=Image
Y=0
X=(-#Ver#)r
H=#SCREENAREAHEIGHT#
W=1
SolidColor=#GridColor#
DynamicVariables=1
Hidden=(#Ver#*38>#SCREENAREAWIDTH#/2?)

[MeterVerticalLine39L]
Meter=Image
Y=0
X=(-#Ver#)r
H=#SCREENAREAHEIGHT#
W=1
SolidColor=#GridColor#
DynamicVariables=1
Hidden=(#Ver#*39>#SCREENAREAWIDTH#/2?)

[MeterVerticalLine40L]
Meter=Image
Y=0
X=(-#Ver#)r
H=#SCREENAREAHEIGHT#
W=1
SolidColor=#GridColor#
DynamicVariables=1
Hidden=(#Ver#*40>#SCREENAREAWIDTH#/2?)

[MeterVerticalLine41L]
Meter=Image
Y=0
X=(-#Ver#)r
H=#SCREENAREAHEIGHT#
W=1
SolidColor=#GridColor#
DynamicVariables=1
Hidden=(#Ver#*41>#SCREENAREAWIDTH#/2?)

[MeterVerticalLine42L]
Meter=Image
Y=0
X=(-#Ver#)r
H=#SCREENAREAHEIGHT#
W=1
SolidColor=#GridColor#
DynamicVariables=1
Hidden=(#Ver#*42>#SCREENAREAWIDTH#/2?)

[MeterVerticalLine43L]
Meter=Image
Y=0
X=(-#Ver#)r
H=#SCREENAREAHEIGHT#
W=1
SolidColor=#GridColor#
DynamicVariables=1
Hidden=(#Ver#*43>#SCREENAREAWIDTH#/2?)

[MeterVerticalLine44L]
Meter=Image
Y=0
X=(-#Ver#)r
H=#SCREENAREAHEIGHT#
W=1
SolidColor=#GridColor#
DynamicVariables=1
Hidden=(#Ver#*44>#SCREENAREAWIDTH#/2?)

[MeterVerticalLine45L]
Meter=Image
Y=0
X=(-#Ver#)r
H=#SCREENAREAHEIGHT#
W=1
SolidColor=#GridColor#
DynamicVariables=1
Hidden=(#Ver#*45>#SCREENAREAWIDTH#/2?)

[MeterVerticalLine46L]
Meter=Image
Y=0
X=(-#Ver#)r
H=#SCREENAREAHEIGHT#
W=1
SolidColor=#GridColor#
DynamicVariables=1
Hidden=(#Ver#*46>#SCREENAREAWIDTH#/2?)

[MeterVerticalLine47L]
Meter=Image
Y=0
X=(-#Ver#)r
H=#SCREENAREAHEIGHT#
W=1
SolidColor=#GridColor#
DynamicVariables=1
Hidden=(#Ver#*47>#SCREENAREAWIDTH#/2?)

[MeterVerticalLine48L]
Meter=Image
Y=0
X=(-#Ver#)r
H=#SCREENAREAHEIGHT#
W=1
SolidColor=#GridColor#
DynamicVariables=1
Hidden=(#Ver#*48>#SCREENAREAWIDTH#/2?)

